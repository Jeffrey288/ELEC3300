# file: T1.ioc
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Mcu.Family=STM32F1
Mcu.Name=STM32F103V(C-D-E)Tx
Mcu.Package=LQFP100
NVIC.PriorityGroup=NVIC_PRIORITYGROUP_4
OSC_IN.Mode=HSE-External-Oscillator
OSC_IN.Signal=RCC_OSC_IN
OSC_OUT.Mode=HSE-External-Oscillator
OSC_OUT.Signal=RCC_OSC_OUT
PA13.Mode=Serial_Wire
PA13.Signal=SYS_JTMS-SWDIO
PA14.Mode=Serial_Wire
PA14.Signal=SYS_JTCK-SWCLK
PC14-OSC32_IN.Mode=LSE-External-Oscillator
PC14-OSC32_IN.Signal=RCC_OSC32_IN
PC15-OSC32_OUT.Mode=LSE-External-Oscillator
PC15-OSC32_OUT.Signal=RCC_OSC32_OUT
ProjectManager.HeapSize=0x200
ProjectManager.StackSize=0x400
ProjectManager.TargetToolchain=STM32CubeIDE
RCC.AHBFreq_Value=72000000
RCC.APB1CLKDivider=RCC_HCLK_DIV2
RCC.APB1Freq_Value=36000000
RCC.APB1TimFreq_Value=72000000
RCC.APB2Freq_Value=72000000
RCC.APB2TimFreq_Value=72000000
RCC.HCLKFreq_Value=72000000
RCC.PLLMUL=RCC_PLL_MUL9
RCC.PLLSourceVirtual=RCC_PLLSOURCE_HSE
RCC.SYSCLKFreq_VALUE=72000000
RCC.SYSCLKSource=RCC_SYSCLKSOURCE_PLLCLK
RCC.USBFreq_Value=72000000
board=custom

// file: Core/Src/main.c
/* USER CODE BEGIN Header */
/**
  ******************************************************************************
  * @file           : main.c
  ******************************************************************************
  T1 : Sample program to illustrate the use of CubeIDE and revise C programming
  data type.
  ******************************************************************************
  */
/* USER CODE END Header */
#include "main.h"

/* USER CODE BEGIN PD */
#define MAX 8
/* USER CODE END PD */

/* USER CODE BEGIN PV */
int i, j;
unsigned short dummy = 65535;
float x;
double y;
int array[MAX];
/* USER CODE END PV */

void SystemClock_Config(void);
static void MX_GPIO_Init(void);

/* USER CODE BEGIN 0 */
int square(int n)
{
   int dummy;	// Can you see any changes when going in the procedure ?
   dummy = n*n; // Where is dummy now, where it should be before entering the procedure ?
   return dummy;
}
/* USER CODE END 0 */

int main(void)
{
  /* USER CODE BEGIN 1 */
	/*
	 * 20851871
	 *
	 *
	 * 20
	 * 08
	 * 85
	 * 51
	 * 18
	 * 87
	 * 71
	 */

  /* USER CODE END 1 */

  /* MCU Configuration--------------------------------------------------------*/

  /* Reset of all peripherals, Initializes the Flash interface and the Systick. */
  HAL_Init();

  /* Configure the system clock */
  SystemClock_Config();

  /* Initialize all configured peripherals */
  MX_GPIO_Init();
  /* USER CODE BEGIN 2 */

  /* Part I : Understanding where to view the variables and Revise of Basic C Programming */
  /*          How STM32 work when executing the program                                   */

  int counter, k;
  int sum;

  // Click Windows -> Show View -> Expressions : Add  i, j, k as New Expression
  // Click Windows -> Show View -> Variables  : Can you add any Variables ?
  // What are the Variables there and can you relate it to how they are being declared ?
  i = 0x12345678; // use Expressions to see where is i, what is the decimal number ?
  j = 0x87654321; // use Expressions to see where is j, what is the decimal number ?
  k = -1;	  // use Expressions to see where is k ? Does is differ from i, j ?

  // Click Windows -> Show View -> Memory
  // In Monitors click + , and input 0x20000000
  // + New Renderings > Select Traditional > Add Rendering
  // See if you can find i, j, k ?

  x = 1234.5678;  // use Expressions to check x, is it correct ?
  y = 12345678.87654321; // how about y ?
  // Try see if you can find x and y memory ?
  // In what format does x and y being stored in memory ?

  dummy = dummy+1;  // why dummy is not 65536 ?

  /* Part II : Procedure calls and concept of scope */
  counter = 0;
  sum = 0;
  while (counter < MAX)
  {
    k = square(counter);  // Go to the procedure square
    array[counter] = k;
    counter++;
    sum += k;
  }

  /* Part III : How can we write assembly code in the STM32 */

  __asm("MOV  R1, 0x5678");
  __asm("MOVT R1, 0x1234");

  /* USER CODE END 2 */

  /* Infinite loop */
  while (1)
  {

  }
}

void SystemClock_Config(void)
{
  RCC_OscInitTypeDef RCC_OscInitStruct = {0};
  RCC_ClkInitTypeDef RCC_ClkInitStruct = {0};

  /** Initializes the RCC Oscillators according to the specified parameters
  * in the RCC_OscInitTypeDef structure.
  */
  RCC_OscInitStruct.OscillatorType = RCC_OSCILLATORTYPE_HSE;
  RCC_OscInitStruct.HSEState = RCC_HSE_ON;
  RCC_OscInitStruct.HSEPredivValue = RCC_HSE_PREDIV_DIV1;
  RCC_OscInitStruct.HSIState = RCC_HSI_ON;
  RCC_OscInitStruct.PLL.PLLState = RCC_PLL_ON;
  RCC_OscInitStruct.PLL.PLLSource = RCC_PLLSOURCE_HSE;
  RCC_OscInitStruct.PLL.PLLMUL = RCC_PLL_MUL9;
  if (HAL_RCC_OscConfig(&RCC_OscInitStruct) != HAL_OK)
  {
    Error_Handler();
  }

  /** Initializes the CPU, AHB and APB buses clocks
  */
  RCC_ClkInitStruct.ClockType = RCC_CLOCKTYPE_HCLK|RCC_CLOCKTYPE_SYSCLK
                              |RCC_CLOCKTYPE_PCLK1|RCC_CLOCKTYPE_PCLK2;
  RCC_ClkInitStruct.SYSCLKSource = RCC_SYSCLKSOURCE_PLLCLK;
  RCC_ClkInitStruct.AHBCLKDivider = RCC_SYSCLK_DIV1;
  RCC_ClkInitStruct.APB1CLKDivider = RCC_HCLK_DIV2;
  RCC_ClkInitStruct.APB2CLKDivider = RCC_HCLK_DIV1;

  if (HAL_RCC_ClockConfig(&RCC_ClkInitStruct, FLASH_LATENCY_2) != HAL_OK)
  {
    Error_Handler();
  }
}

static void MX_GPIO_Init(void)
{

  /* GPIO Ports Clock Enable */
  __HAL_RCC_GPIOC_CLK_ENABLE();
  __HAL_RCC_GPIOA_CLK_ENABLE();

}

void Error_Handler(void)
{
  __disable_irq();
  while (1)
  {
  }
}
